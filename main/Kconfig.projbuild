## main/Kconfig.projbuild
```kconfig
menu "OBD DSP Configuration"
    config OBD_POLL_SELF_CHECK
        bool "Record OBD polling self-check results"
        default y
        help
            Record requested/received PID bitsets for trip diagnostics.
            Disable for the connection regression comparison build. Existing
            stored records and the phone protocol remain readable.

    config OBD_EXPERIMENTAL_GEAR_POLL
        bool "Experimental OBD A0/A4 gear queries"
        default n
        help
            Adds optional transmission capability/ratio queries to slot 11.
            BRZ vehicle/adapter support has not been verified. Leave disabled
            for the v4.0.0 default acquisition sequence and RPM/speed gear
            inference. Passive trip poll-health recording remains available.

    config OBD_PERF_MONITOR
        bool "Passive gauge performance telemetry"
        default n
        help
            Best-effort RAM-only timestamp events. An idle-priority background
            task reports to the serial log every 10 seconds. No extra OBD
            queries, blocking producer locks, Flash writes or BLE messages.
            Full/contended buffers drop telemetry, never vehicle samples.
            Opt-in diagnostics only. Memory is allocated after core startup
            with an internal-heap reserve; allocation failure disables telemetry.
            Production builds leave this off to preserve radio/OTA headroom.

    choice OBD_BOARD_VARIANT
        prompt "Gauge board"
        default OBD_BOARD_AMOLED_175
        help
            Select the physical Waveshare board. The AMOLED-1.75-B entry uses
            Waveshare's maintained CO5300/CST9217 ESP-IDF BSP. The legacy LCD
            entry keeps the original local ST77916/CST816 drivers.

        config OBD_BOARD_AMOLED_175
            bool "ESP32-S3-Touch-AMOLED-1.75 / 1.75-B (466x466)"

        config OBD_BOARD_LCD_185
            bool "ESP32-S3-Touch-LCD-1.85 (360x360 legacy)"
    endchoice

    config OBD_RS485_TX_GPIO
        int "RS485 TX GPIO"
        range 0 48
        default 13
        help
            UART TX pin used by the RS485 brake temperature module.
            Do not use GPIO43/44 on this board because they are typically tied to
            the onboard USB-UART bridge.

    config OBD_RS485_RX_GPIO
        int "RS485 RX GPIO"
        range 0 48
        default 12
        help
            UART RX pin used by the RS485 brake temperature module.

    config OBD_RS485_DE_RE_GPIO
        int "RS485 DE/RE GPIO (-1 disables direction control)"
        range -1 48
        default -1
        help
            Optional GPIO to control RS485 transceiver direction.
            Set HIGH when transmitting and LOW when receiving.
            Keep -1 if your USB/RS485 module handles direction automatically.
endmenu
```
